## config/west.yml
```yaml
manifest:
  remotes:
    - name: uruz-7
      url-base: https://github.com/uruz-7
  projects:
    - name: zmk
      remote: uruz-7
      revision: v0.3.5
      import: app/west.yml
  self:
    path: config
```
